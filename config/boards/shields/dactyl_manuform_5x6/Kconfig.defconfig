## config/boards/shields/dactyl_manuform_5x6/Kconfig.defconfig
```kconfig
if SHIELD_DACTYL_MANUFORM_5x6_LEFT

    config ZMK_KEYBOARD_NAME
        default "Taiko Dactyl (Left)"

    config ZMK_SPLIT_BLE_ROLE_CENTRAL
        default y

endif

if SHIELD_DACTYL_MANUFORM_5x6_RIGHT

    config ZMK_KEYBOARD_NAME
        default "Taiko Dactyl (Right)"

endif

if SHIELD_DACTYL_MANUFORM_5x6_LEFT || SHIELD_DACTYL_MANUFORM_5x6_RIGHT

    config ZMK_SPLIT
        default y

endif
```
